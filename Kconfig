## Kconfig
```kconfig
menu "eshet"

    config ESHET_HOST
        string "eshet host to connect to"
        default 'server.lan'

    config ESHET_PORT
        int "eshet port to connect to"
        default 11235

endmenu
```

## example/sdkconfig.defaults
```kconfig
CONFIG_SIMPLE_WIFI_SSID="wifi_ssid"
CONFIG_SIMPLE_WIFI_PASSWORD="wifi_pass"
CONFIG_LWIP_LOCAL_HOSTNAME="eshet_example.lan"
CONFIG_ESHET_HOST="server.lan"

CONFIG_COMPILER_CXX_EXCEPTIONS=y
CONFIG_PARTITION_TABLE_TWO_OTA=y
CONFIG_BOOTLOADER_APP_ROLLBACK_ENABLE=y
CONFIG_ESPTOOLPY_FLASHSIZE_4MB=y
CONFIG_FREERTOS_HZ=500
```
